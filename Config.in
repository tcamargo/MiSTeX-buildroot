## configs/mistex-orangepi-zero-2w_defconfig
```kconfig
BR2_aarch64=y
BR2_cortex_a53=y
BR2_ARM_FPU_VFPV4=y

BR2_PACKAGE_HOST_LINUX_HEADERS_CUSTOM_6_6=y
BR2_ROOTFS_DEVICE_CREATION_DYNAMIC_EUDEV=y
BR2_ROOTFS_OVERLAY="$(BR2_EXTERNAL_MISTEX_PATH)/board/mistex/fsoverlay $(BR2_EXTERNAL_MISTEX_PATH)/board/mistex/orangepi/orangepi-zero-2w/fsoverlay"
BR2_GLOBAL_PATCH_DIR="$(BR2_EXTERNAL_MISTEX_PATH)/board/mistex/patches $(BR2_EXTERNAL_MISTEX_PATH)/board/mistex/orangepi/orangepi-zero-2w/patches"

# Firmware
BR2_TARGET_ARM_TRUSTED_FIRMWARE=y
BR2_TARGET_ARM_TRUSTED_FIRMWARE_CUSTOM_VERSION=y
BR2_TARGET_ARM_TRUSTED_FIRMWARE_CUSTOM_VERSION_VALUE="v2.10"
BR2_TARGET_ARM_TRUSTED_FIRMWARE_PLATFORM="sun50i_h616"
BR2_TARGET_ARM_TRUSTED_FIRMWARE_BL31=y

# Bootloader
BR2_TARGET_UBOOT=y
BR2_TARGET_UBOOT_BUILD_SYSTEM_KCONFIG=y
BR2_TARGET_UBOOT_CUSTOM_VERSION=y
## first version with OrangePi Zero 2w support
BR2_TARGET_UBOOT_CUSTOM_VERSION_VALUE="2024.04-rc4"
BR2_TARGET_UBOOT_BOARD_DEFCONFIG="orangepi_zero2w"
BR2_TARGET_UBOOT_NEEDS_DTC=y
BR2_TARGET_UBOOT_NEEDS_OPENSSL=y
BR2_TARGET_UBOOT_NEEDS_PYTHON3=y
BR2_TARGET_UBOOT_NEEDS_PYLIBFDT=y
BR2_TARGET_UBOOT_NEEDS_ATF_BL31=y
BR2_TARGET_UBOOT_SPL=y
BR2_TARGET_UBOOT_SPL_NAME="u-boot-sunxi-with-spl.bin"
BR2_TARGET_UBOOT_CUSTOM_MAKEOPTS="SCP=/dev/null"

# Kernel
BR2_LINUX_KERNEL=y
BR2_LINUX_KERNEL_CUSTOM_VERSION=y
## first version with OrangePi Zero 2w support
BR2_LINUX_KERNEL_CUSTOM_VERSION_VALUE="6.8"
BR2_LINUX_KERNEL_USE_ARCH_DEFAULT_CONFIG=y
BR2_LINUX_KERNEL_DTS_SUPPORT=y
BR2_LINUX_KERNEL_INTREE_DTS_NAME="allwinner/sun50i-h618-orangepi-zero2w"
# BR2_LINUX_KERNEL_CONFIG_FRAGMENT_FILES="board/orangepi/orangepi-zero-plus2/linux-extras.config"
BR2_LINUX_KERNEL_NEEDS_HOST_OPENSSL=y
BR2_LINUX_KERNEL_INSTALL_TARGET=y
BR2_LINUX_KERNEL_DTB_KEEP_DIRNAME=y

# wireless firmware
BR2_PACKAGE_LINUX_FIRMWARE=y
BR2_PACKAGE_LINUX_FIRMWARE_BRCM_BCM43XXX=y

# wireless tools
BR2_PACKAGE_IW=y
BR2_PACKAGE_WIRELESS_TOOLS=y
BR2_PACKAGE_WIRELESS_TOOLS_LIB=y
BR2_PACKAGE_WPA_SUPPLICANT=y
BR2_PACKAGE_WPA_SUPPLICANT_NL80211=y
BR2_PACKAGE_WPA_SUPPLICANT_CLI=y

# Filesystem
BR2_TARGET_ROOTFS_EXT2=y
BR2_TARGET_ROOTFS_EXT2_4=y
BR2_TARGET_ROOTFS_EXT2_SIZE="128M"

# host tools
BR2_PACKAGE_HOST_GENIMAGE=y

# image scripts
BR2_ROOTFS_POST_BUILD_SCRIPT="$(BR2_EXTERNAL_MISTEX_PATH)/board/orangepi/common/post-build.sh"
BR2_ROOTFS_POST_IMAGE_SCRIPT="$(BR2_EXTERNAL_MISTEX_PATH)/board/orangepi/common/genimage.sh"
BR2_ROOTFS_POST_SCRIPT_ARGS="-c $(BINARIES_DIR)/genimage.cfg"

# # Enables ccache
BR2_CCACHE=y

# BR2_aarch64=y
# BR2_cortex_a53=y
# BR2_ARM_FPU_VFPV4=y
# BR2_TOOLCHAIN_BUILDROOT_CXX=y
# BR2_PACKAGE_HOST_LINUX_HEADERS_CUSTOM_6_7=y
# BR2_TARGET_GENERIC_HOSTNAME="MiSTeX"
# BR2_ROOTFS_DEVICE_CREATION_DYNAMIC_MDEV=y
# BR2_TARGET_GENERIC_ROOT_PASSWD="1234"
# BR2_SYSTEM_DHCP="eth0"
# 
# # Firmware
# BR2_GLOBAL_PATCH_DIR="$(BR2_EXTERNAL_MISTEX_PATH)/board/mistex/fsoverlay $(BR2_EXTERNAL_MISTEX_PATH)/board/orangepi/orangepi-zero-2w/fsoverlay"
# BR2_ROOTFS_POST_BUILD_SCRIPT="$(BR2_EXTERNAL_MISTEX_PATH)/board/orangepi/common/post-build.sh"
# BR2_ROOTFS_POST_IMAGE_SCRIPT="$(BR2_EXTERNAL_MISTEX_PATH)/board/orangepi/common/genimage.sh"
# BR2_ROOTFS_POST_SCRIPT_ARGS="-c $(BINARIES_DIR)/genimage.cfg"
# BR2_GLOBAL_PATCH_DIR="$(BR2_EXTERNAL_MISTEX_PATH)/board/mistex/patches $(BR2_EXTERNAL_MISTEX_PATH)/board/mistex/orangepi/orangepi-zero-2w/patches"
# BR2_LINUX_KERNEL=y
# BR2_LINUX_KERNEL_CUSTOM_VERSION=y
# BR2_LINUX_KERNEL_CUSTOM_VERSION_VALUE="6.7"
# BR2_LINUX_KERNEL_USE_ARCH_DEFAULT_CONFIG=y
# BR2_LINUX_KERNEL_DTS_SUPPORT=y
# BR2_LINUX_KERNEL_INTREE_DTS_NAME="allwinner/sun50i-h618-orangepi-zero3"
# BR2_LINUX_KERNEL_DTB_KEEP_DIRNAME=y
# BR2_LINUX_KERNEL_INSTALL_TARGET=y
# BR2_LINUX_KERNEL_NEEDS_HOST_OPENSSL=y
# BR2_PACKAGE_DOSFSTOOLS=y
# BR2_PACKAGE_DOSFSTOOLS_FATLABEL=y
# BR2_PACKAGE_DOSFSTOOLS_FSCK_FAT=y
# BR2_PACKAGE_DOSFSTOOLS_MKFS_FAT=y
# BR2_PACKAGE_EXFAT=y
# BR2_PACKAGE_OPENFPGALOADER=y
# BR2_PACKAGE_OPENFPGALOADER_LIBGPIOD=y
# BR2_PACKAGE_RASPI_GPIO=y
# BR2_PACKAGE_RTL8188EU=y
# BR2_PACKAGE_RTL8189ES=y
# BR2_PACKAGE_RTL8189FS=y
# BR2_PACKAGE_RTL8192EU=y
# BR2_PACKAGE_RTL8723BU=y
# BR2_PACKAGE_RTL8723DS=y
# BR2_PACKAGE_SPI_TOOLS=y
# BR2_PACKAGE_PYTHON3=y
# BR2_PACKAGE_PYTHON_RPI_GPIO=y
# BR2_PACKAGE_DHCPCD=y
# BR2_PACKAGE_IW=y
# BR2_PACKAGE_IWD=y
# BR2_PACKAGE_OPENSSH=y
# BR2_PACKAGE_WPA_SUPPLICANT=y
# BR2_PACKAGE_WPA_SUPPLICANT_WIRED=y
# BR2_PACKAGE_WPA_SUPPLICANT_CLI=y
# BR2_PACKAGE_WPA_SUPPLICANT_WPA_CLIENT_SO=y
# BR2_PACKAGE_WPA_SUPPLICANT_PASSPHRASE=y
# BR2_PACKAGE_HTOP=y
# BR2_PACKAGE_NANO=y
# BR2_TARGET_ROOTFS_EXT2=y
# BR2_TARGET_ROOTFS_EXT2_4=y
# BR2_TARGET_ROOTFS_EXT2_SIZE="240M"
# # BR2_TARGET_ROOTFS_TAR is not set
# BR2_TARGET_ARM_TRUSTED_FIRMWARE=y
# BR2_TARGET_ARM_TRUSTED_FIRMWARE_CUSTOM_VERSION=y
# BR2_TARGET_ARM_TRUSTED_FIRMWARE_CUSTOM_VERSION_VALUE="v2.10"
# BR2_TARGET_ARM_TRUSTED_FIRMWARE_PLATFORM="sun50i_h616"
# BR2_TARGET_ARM_TRUSTED_FIRMWARE_BL31=y
# 
# # Bootloader
# BR2_TARGET_UBOOT=y
# BR2_TARGET_UBOOT_BUILD_SYSTEM_KCONFIG=y
# BR2_TARGET_UBOOT_CUSTOM_VERSION=y
# BR2_TARGET_UBOOT_CUSTOM_VERSION_VALUE="2024.01"
# BR2_TARGET_UBOOT_BOARD_DEFCONFIG="orangepi_zero3"
# BR2_TARGET_UBOOT_NEEDS_DTC=y
# BR2_TARGET_UBOOT_NEEDS_OPENSSL=y
# BR2_TARGET_UBOOT_NEEDS_PYTHON3=y
# BR2_TARGET_UBOOT_NEEDS_PYLIBFDT=y
# BR2_TARGET_UBOOT_NEEDS_OPENSSL=y
# BR2_TARGET_UBOOT_NEEDS_ATF_BL31=y
# BR2_TARGET_UBOOT_SPL=y
# BR2_TARGET_UBOOT_SPL_NAME="u-boot-sunxi-with-spl.bin"
# BR2_TARGET_UBOOT_CUSTOM_MAKEOPTS="SCP=/dev/null"
# BR2_PACKAGE_HOST_GENIMAGE=y
# BR2_PACKAGE_HOST_UBOOT_TOOLS=y
# 
# # Bluetooth is important for game controllers
# BR2_PACKAGE_BLUEZ5_UTILS_HEADERS=y
# BR2_PACKAGE_LIBCURL=y
# BR2_PACKAGE_LIBCURL_CURL=y
# BR2_PACKAGE_LIBCURL_VERBOSE=y
# BR2_PACKAGE_LIBCURL_PROXY_SUPPORT=y
# BR2_PACKAGE_LIBCURL_COOKIES_SUPPORT=y
# BR2_PACKAGE_LIBCURL_EXTRA_PROTOCOLS_FEATURES=y
# BR2_PACKAGE_LIBCURL_OPENSSL=y
# BR2_PACKAGE_BLUEZ_TOOLS=y
# BR2_PACKAGE_BLUEZ5_UTILS=y
# BR2_PACKAGE_BLUEZ5_UTILS_OBEX=y
# BR2_PACKAGE_BLUEZ5_UTILS_CLIENT=y
# BR2_PACKAGE_BLUEZ5_UTILS_DEPRECATED=y
# BR2_PACKAGE_BLUEZ5_UTILS_EXPERIMENTAL=y
# BR2_PACKAGE_BLUEZ5_UTILS_PLUGINS_HEALTH=y
# BR2_PACKAGE_BLUEZ5_UTILS_PLUGINS_MESH=y
# BR2_PACKAGE_BLUEZ5_UTILS_PLUGINS_MIDI=y
# BR2_PACKAGE_BLUEZ5_UTILS_PLUGINS_NFC=y
# BR2_PACKAGE_BLUEZ5_UTILS_PLUGINS_SAP=y
# BR2_PACKAGE_BLUEZ5_UTILS_PLUGINS_SIXAXIS=y
# BR2_PACKAGE_BLUEZ5_UTILS_TEST=y
# BR2_PACKAGE_BLUEZ5_UTILS_TOOLS_HID2HCI=y
# BR2_PACKAGE_BMON=y
# 
# # Main-MiSTer needs boost
# BR2_PACKAGE_BOOST=y
# BR2_PACKAGE_BOOST_LAYOUT_SYSTEM=y
# BR2_PACKAGE_BOOST_LAYOUT="system"
# BR2_PACKAGE_LIBEVDEV=y
# 
# # serial is quite a necessity on embedded
# BR2_PACKAGE_LIBSERIAL=y
# BR2_PACKAGE_LIBSERIALPORT=y
# 
# # USB is essential for game controllers
# BR2_PACKAGE_LIBUSB=y
# BR2_PACKAGE_LIBUSB_COMPAT=y
# 
# # we need input stuff for game controllers, I suppose
# BR2_PACKAGE_LIBHID=y
# BR2_PACKAGE_LIBIIO=y
# BR2_PACKAGE_LIBIIO_LOCAL_BACKEND=y
# BR2_PACKAGE_LIBIIO_XML_BACKEND=y
# BR2_PACKAGE_LIBIIO_NETWORK_BACKEND=y
# BR2_PACKAGE_LIBIIO_USB_BACKEND=y
# BR2_PACKAGE_LIBIIO_SERIAL_BACKEND=y
# BR2_PACKAGE_LIBIIO_IIOD=y
# BR2_PACKAGE_LIBIIO_IIOD_USBD=y
# BR2_PACKAGE_LIBINPUT=y
# 
# # JSON/XML
# # Those are very likely needed, I think.
# BR2_PACKAGE_EXPAT=y
# BR2_PACKAGE_JSON_C=y
# BR2_PACKAGE_LIBXML2=y
# 
# # DTC always comes in handy on ARM
# BR2_PACKAGE_DTC=y
# 
# # openFPGALoader potentially needs this
# BR2_PACKAGE_LIBFTDI=y
# BR2_PACKAGE_LIBFTDI_CPP=y
# BR2_PACKAGE_LIBFTDI1=y
# 
# # Compression and decompression, those are Main-MiSTer dependencies
# BR2_PACKAGE_LZO=y
# BR2_PACKAGE_ZLIB=y
# BR2_PACKAGE_BZIP2=y
# BR2_PACKAGE_LIBZLIB=y
# BR2_PACKAGE_HAS_ZLIB=y
# BR2_PACKAGE_PROVIDES_ZLIB="libzlib"
# BR2_PACKAGE_PROVIDES_HOST_ZLIB="host-libzlib"
# 
# # MiSTeX needs freetype, imlib2, libjpeg
# BR2_PACKAGE_FONTCONFIG=y
# BR2_PACKAGE_FREETYPE=y
# BR2_PACKAGE_GIFLIB=y
# BR2_PACKAGE_IMLIB2=y
# BR2_PACKAGE_IMLIB2_JPEG=y
# BR2_PACKAGE_IMLIB2_PNG=y
# BR2_PACKAGE_IMLIB2_GIF=y
# BR2_PACKAGE_IMLIB2_ID3=y
# BR2_PACKAGE_JPEG=y
# BR2_PACKAGE_LIBJPEG=y
# BR2_PACKAGE_HAS_JPEG=y
# BR2_PACKAGE_PROVIDES_JPEG="libjpeg"
# BR2_PACKAGE_LIBPNG=y
# BR2_PACKAGE_OPENJPEG=y
# BR2_PACKAGE_TIFF=y
# BR2_PACKAGE_TIFF_CCITT=y
# BR2_PACKAGE_TIFF_PACKBITS=y
# BR2_PACKAGE_TIFF_LZW=y
# BR2_PACKAGE_TIFF_THUNDER=y
# BR2_PACKAGE_TIFF_NEXT=y
# BR2_PACKAGE_TIFF_LOGLUV=y
# BR2_PACKAGE_TIFF_MDI=y
# BR2_PACKAGE_TIFF_ZLIB=y
# 
# # BR2_PACKAGE_TIFF_XZ is not set
# BR2_PACKAGE_TIFF_PIXARLOG=y
# BR2_PACKAGE_TIFF_JPEG=y
# BR2_PACKAGE_TIFF_OLD_JPEG=y
# BR2_PACKAGE_TIFF_JBIG=y
# 
# # SPI is our umbilical cord to the FPGA, absolutely mandatory
# BR2_PACKAGE_SPI_TOOLS=y
# BR2_PACKAGE_HAS_UDEV=y
# BR2_PACKAGE_USBMOUNT=y
# BR2_PACKAGE_USBUTILS=y
# 
# # Linux Kernel Tools
# BR2_PACKAGE_LINUX_TOOLS=y
# BR2_PACKAGE_LINUX_TOOLS_CPUPOWER=y
# BR2_PACKAGE_LINUX_TOOLS_GPIO=y
# 
# # UDEV
# BR2_PACKAGE_HAS_UDEV=y
# BR2_PACKAGE_UDEV=y
# BR2_PACKAGE_EUDEV=y
# BR2_PACKAGE_EUDEV_RULES_GEN=y
# BR2_PACKAGE_EUDEV_ENABLE_HWDB=y
# BR2_PACKAGE_HOST_EUDEV=y
# 
```
